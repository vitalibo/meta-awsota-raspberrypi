## build/conf/bblayers.conf
```bitbake
POKY_BBLAYERS_CONF_VERSION = "2"

BBPATH = "${TOPDIR}"
BBFILES ?= ""
SRCPATH ?= "${TOPDIR}/../src"

BBLAYERS ?= " \
  ${SRCPATH}/poky/meta \
  ${SRCPATH}/poky/meta-poky \
  ${SRCPATH}/poky/meta-yocto-bsp \
  ${SRCPATH}/meta-openembedded/meta-oe \
  ${SRCPATH}/meta-openembedded/meta-python \
  ${SRCPATH}/meta-openembedded/meta-networking \
  ${SRCPATH}/meta-openembedded/meta-multimedia \
  ${SRCPATH}/meta-raspberrypi \
  ${SRCPATH}/meta-mender/meta-mender-core \
  ${SRCPATH}/meta-mender/meta-mender-raspberrypi \
  ${SRCPATH}/meta-java \
  ${SRCPATH}/meta-aws \
  ${SRCPATH}/meta-awsota-raspberrypi \
"
```

## build/conf/local.conf
```bitbake
MACHINE = "raspberrypi4"
DISTRO = "poky"
PACKAGE_CLASSES = "package_rpm"

EXTRA_IMAGE_FEATURES ?= "debug-tweaks"
USER_CLASSES ?= "buildstats image-mklibs image-prelink"
PATCHRESOLVE = "noop"
PACKAGECONFIG_append_pn-qemu-system-native = " sdl"
CONF_VERSION = "1"

INHERIT += "rm_work"
INHERIT += "mender-full"

MENDER_ARTIFACT_NAME = "release-1"

DISTRO_FEATURES_append = " systemd"
VIRTUAL-RUNTIME_init_manager = "systemd"
DISTRO_FEATURES_BACKFILL_CONSIDERED = "sysvinit"
VIRTUAL-RUNTIME_initscripts = ""

RPI_USE_U_BOOT = "1"
MENDER_BOOT_PART_SIZE_MB = "40"
MENDER_STORAGE_TOTAL_SIZE_MB = "3072"
IMAGE_INSTALL_append = " kernel-image kernel-devicetree"
IMAGE_FSTYPES_remove += " rpi-sdimg"

MENDER_FEATURES_ENABLE_append = " mender-uboot mender-image-sd"
MENDER_FEATURES_DISABLE_append = " mender-grub mender-image-uefi"

EXTRA_IMAGE_FEATURES += " ssh-server-dropbear"

KERNEL_DEVICETREE = "bcm2711-rpi-4-b.dtb"
ENABLE_UART = "1"

IMAGE_INSTALL_append = " aws-iot-jobs"
AWS_IOT_ENDPOINT = "1qaz2wsx3edc-ats.iot.us-east-1.amazonaws.com"
```

## src/meta-awsota-raspberrypi/conf/layer.conf
```bitbake
BBPATH .= ":${LAYERDIR}"

BBFILES += " \
  ${LAYERDIR}/recipes-*/*/*.bb \
  ${LAYERDIR}/recipes-*/*/*.bbappend \
"

BBFILE_COLLECTIONS += "meta-awsota-raspberrypi"
BBFILE_PATTERN_meta-awsota-raspberrypi = "^${LAYERDIR}/"
BBFILE_PRIORITY_meta-awsota-raspberrypi = "10"

LAYERSERIES_COMPAT_meta-awsota-raspberrypi = "dunfell"
```
